## sdkconfig.defaults
```kconfig
# sdkconfig.defaults — Matter 开窗器 / XIAO ESP32-C6
CONFIG_IDF_TARGET="esp32c6"

# ── 控制台 ──────────────────────────────────────────────────────────────────
# 关掉 USB-Serial-JTAG 控制台：USJ 外设/PHY 常开会让 ICD LIT 平均功耗升高 mA 级
# 调试时临时改回 CONFIG_ESP_CONSOLE_USB_SERIAL_JTAG=y 烧调试固件
CONFIG_ESP_CONSOLE_NONE=y
CONFIG_ESP_CONSOLE_SECONDARY_NONE=y
# OpenThread 控制台也别挂 USJ
CONFIG_OPENTHREAD_CONSOLE_TYPE_UART=y

# ── 蓝牙（NimBLE，Matter BLE 配网） ───────────────────────────────────────
CONFIG_BT_ENABLED=y
CONFIG_BT_NIMBLE_ENABLED=y
CONFIG_BT_NIMBLE_LOG_LEVEL=3
CONFIG_BT_BLUEDROID_ENABLED=n
CONFIG_BT_CONTROLLER_ENABLED=y
CONFIG_BT_NIMBLE_ENABLE_CONN_REATTEMPT=n

# ── Flash（XIAO ESP32-C6 内置 4MB） ────────────────────────────────────────
CONFIG_ESPTOOLPY_FLASHSIZE_4MB=y

# ── 自定义分区表 ────────────────────────────────────────────────────────────
CONFIG_PARTITION_TABLE_CUSTOM=y
CONFIG_PARTITION_TABLE_FILENAME="partitions.csv"
CONFIG_PARTITION_TABLE_OFFSET=0xC000

# ── Thread / OpenThread（ESP32-C6 内置 802.15.4） ──────────────────────────
CONFIG_OPENTHREAD_ENABLED=y
CONFIG_OPENTHREAD_RADIO_NATIVE=y
CONFIG_OPENTHREAD_MTD=y
CONFIG_OPENTHREAD_SRP_CLIENT=y
CONFIG_OPENTHREAD_DNS_CLIENT=y
CONFIG_OPENTHREAD_LOG_LEVEL_DYNAMIC=n
CONFIG_OPENTHREAD_LOG_LEVEL_NOTE=y
CONFIG_OPENTHREAD_CLI=n
CONFIG_IEEE802154_ENABLED=y

# ── 禁用 Wi-Fi（改用 Thread） ────────────────────────────────────────────
CONFIG_ENABLE_WIFI_STATION=n

# ── IPv6 / LwIP（Thread 管理 IPv6，禁用 LwIP 自动配置避免冲突） ──────────
# 官方例子注释：Disable lwip ipv6 autoconfig - 由 OpenThread 管理
CONFIG_LWIP_IPV6_AUTOCONFIG=n
CONFIG_LWIP_HOOK_IP6_ROUTE_DEFAULT=y
CONFIG_LWIP_HOOK_ND6_GET_GW_DEFAULT=y
CONFIG_LWIP_IPV6_NUM_ADDRESSES=8
CONFIG_LWIP_MULTICAST_PING=y
# Thread 纯 IPv6，禁用 IPv4 节省内存
CONFIG_LWIP_ND6=n
CONFIG_LWIP_IPV4=n
CONFIG_DISABLE_IPV4=y

# ── mDNS（禁用 minimal，使用完整平台实现，官方 Thread 例子要求） ─────────
CONFIG_USE_MINIMAL_MDNS=n

# ── Matter ──────────────────────────────────────────────────────────────────
CONFIG_ESP_MATTER_MAX_DYNAMIC_ENDPOINT_COUNT=4
CONFIG_MBEDTLS_HKDF_C=y
CONFIG_MBEDTLS_SSL_PROTO_DTLS=y
CONFIG_ENABLE_OTA_REQUESTOR=n
CONFIG_ENABLE_CHIP_SHELL=n

# ── FreeRTOS ─────────────────────────────────────────────────────────────────
CONFIG_FREERTOS_HZ=1000

# ── 省电 / ICD ───────────────────────────────────────────────────────────────
CONFIG_PM_ENABLE=y
CONFIG_PM_DFS_INIT_AUTO=y
CONFIG_FREERTOS_USE_TICKLESS_IDLE=y
CONFIG_IEEE802154_SLEEP_ENABLE=y
# 注意：CONFIG_PM_POWER_DOWN_PERIPHERAL_IN_LIGHT_SLEEP=y 会导致 iot_button
# 在 light sleep 后丢按键（GPIO 外设掉电没人重注册唤醒源），不要打开

# ICD（Intermittently Connected Device）— 电池设备必须开启
# 让设备成为 SED，HomePod mini 缓存消息，设备按间隔轮询取数据
CONFIG_ENABLE_ICD_SERVER=y
CONFIG_ICD_SLOW_POLL_INTERVAL_MS=5000
CONFIG_ICD_FAST_POLL_INTERVAL_MS=500
CONFIG_ICD_ACTIVE_MODE_INTERVAL_MS=2000
CONFIG_ICD_ACTIVE_MODE_THRESHOLD_MS=5000
CONFIG_ICD_IDLE_MODE_INTERVAL_SEC=600
CONFIG_ENABLE_ICD_LIT=y
CONFIG_ICD_CLIENTS_SUPPORTED_PER_FABRIC=2

# ── 只启用开窗器需要的 Cluster ──────────────────────────────────────────────
CONFIG_SUPPORT_WINDOW_COVERING_CLUSTER=y
CONFIG_SUPPORT_DOOR_LOCK_CLUSTER=n
CONFIG_SUPPORT_THERMOSTAT_CLUSTER=n
CONFIG_SUPPORT_FAN_CONTROL_CLUSTER=n
CONFIG_SUPPORT_SWITCH_CLUSTER=n
CONFIG_SUPPORT_AIR_QUALITY_CLUSTER=n
CONFIG_SUPPORT_SMOKE_CO_ALARM_CLUSTER=n
CONFIG_SUPPORT_CHANNEL_CLUSTER=n
CONFIG_SUPPORT_MEDIA_PLAYBACK_CLUSTER=n
CONFIG_SUPPORT_KEYPAD_INPUT_CLUSTER=n
CONFIG_SUPPORT_CONTENT_LAUNCHER_CLUSTER=n
CONFIG_SUPPORT_AUDIO_OUTPUT_CLUSTER=n
CONFIG_SUPPORT_APPLICATION_LAUNCHER_CLUSTER=n
CONFIG_SUPPORT_APPLICATION_BASIC_CLUSTER=n
CONFIG_SUPPORT_LOW_POWER_CLUSTER=n
CONFIG_SUPPORT_OCCUPANCY_SENSING_CLUSTER=n
CONFIG_SUPPORT_ICD_MANAGEMENT_CLUSTER=y
CONFIG_SUPPORT_OPERATIONAL_STATE_CLUSTER=n
CONFIG_SUPPORT_ELECTRICAL_ENERGY_MEASUREMENT_CLUSTER=n
CONFIG_SUPPORT_ELECTRICAL_POWER_MEASUREMENT_CLUSTER=n
CONFIG_SUPPORT_DEVICE_ENERGY_MANAGEMENT_CLUSTER=n
CONFIG_SUPPORT_SOFTWARE_DIAGNOSTICS_CLUSTER=n
CONFIG_SUPPORT_DIAGNOSTIC_LOGS_CLUSTER=n
CONFIG_SUPPORT_FAULT_INJECTION_CLUSTER=n
CONFIG_SUPPORT_UNIT_TESTING_CLUSTER=n
CONFIG_SUPPORT_SAMPLE_MEI_CLUSTER=n
```
